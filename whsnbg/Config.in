## whsnbg/Config.in
```kconfig
# whsnbg config

menu  "Configuration"
    depends on PACKAGE_whsnbg
	
	config WHSNBG_DAEMON
		bool "Daemon version"
		default y
		help
			bla-bla-bla help: WHSNBG_DAEMON

	config WHSNBG_STATIC
		bool "Static link"
		default n
		help
			bla-bla-bla help: WHSNBG_STATIC

	config WHSNBG_DPRINTF
		bool "Detailed log"
		default n
		help
			bla-bla-bla help: WHSNBG_DPRINTF

	config WHSNBG_RULES_ENGINE
		bool "Rules engine"
		default y
		help
			bla-bla-bla help: WHSNBG_RULES_ENGINE

	choice
		prompt "TLS support"
		default WHSNBG_AXTLS_LIBRARY
		help
			bla-bla-bla help: TLS support
		config WHSNBG_AXTLS_LIBRARY
			bool "axTLS"
			select PACKAGE_libaxtls
		config WHSNBG_OPENSSL_LIBRARY
			bool "OpenSSL"
			select PACKAGE_libopenssl
	endchoice

	menuconfig WHSNBG_SENSOR_DATA
		bool "HomeWSN.com sensors support"
		default y
		help
			Automatic decoding of the MQTT-SN message payload from the sensors

		config WHSNBG_SENSOR_DATA_MYSQL
			bool "Storing decoded data from the sensors in the MySQL database" if WHSNBG_SENSOR_DATA
			default WHSNBG_SENSOR_DATA
			select PACKAGE_libmysqlclient
			help
				Storing decoded data from the sensors in the MySQL database

		config WHSNBG_MQTT_DATA_MYSQL
			bool "Storing payload from the specific MQTT topics in the MySQL database" if WHSNBG_SENSOR_DATA
			default WHSNBG_SENSOR_DATA
			select PACKAGE_libmysqlclient
			help
				Storing payload from the specific MQTT topics in the MySQL database


endmenu
```
